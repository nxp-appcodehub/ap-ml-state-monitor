## west.yml
```yaml
# The west manifest file (west.yml) for MCUXpresso SDK overall delivery.
#
# The per-workspace west configuration file, ${workspace_path}/.west/config,
# specifies the path of the project containing this manifest file, the
# path is relative to the workspace location ${workspace_path}.
#
#     [manifest]
#     path = appswpacks-ml-state-monitor
#
# See the west documentation for more information:
#
# https://docs.zephyrproject.org/latest/guides/west/index.html

manifest:

  remotes:
    - name: nxpmicro
      url-base: https://github.com/NXPmicro

  defaults:
    remote: nxpmicro

  projects:
    - name: mcux-sdk
      revision: MCUX_2.12.0
      path: core
      import:
        name-allowlist:
          - FreeRTOS-Kernel
          - fatfs
          - mcux-sdk-middleware-sdmmc
          - mcux-sdk-middleware-eiq
          - mcux-sdk-middleware-deepviewrt
          - mcux-sdk-middleware-glow
          - mcux-sdk-middleware-tensorflow
  self:
    path: examples
```
